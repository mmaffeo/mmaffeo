/*###ICF### Section handled by ICF editor, don't touch! ****/
/*-Editor annotation file-*/
/* IcfEditorFile="$TOOLKIT_DIR$\config\ide\IcfEditor\cortex_v1_0.xml" */
/*-Specials-*/
define symbol __ICFEDIT_intvec_start__ = 0x00000000;
/*-Memory Regions-*/
define symbol __ICFEDIT_region_ROM_start__ = 0x08008000;
define symbol __ICFEDIT_region_ROM_end__   = 0x0800BFFF;
define symbol __ICFEDIT_region_RAM_start__ = 0x1fffffff;
define symbol __ICFEDIT_region_RAM_end__   = 0x1fffffff;
/*-Sizes-*/
define symbol __ICFEDIT_size_cstack__ = 0x0000;
define symbol __ICFEDIT_size_heap__   = 0x0000;
/**** End of ICF editor section. ###ICF###*/

define symbol __checksum_start__    = 0x0800BFFC;

define memory mem with size = 4G;
define region ROM_region = mem:[from (__ICFEDIT_region_ROM_start__)  to __ICFEDIT_region_ROM_end__];
place in ROM_region { readonly section .ecuid };
place at address   mem:__checksum_start__       { readonly section .checksum};
keep { section .ecuid, readonly section .checksum };
